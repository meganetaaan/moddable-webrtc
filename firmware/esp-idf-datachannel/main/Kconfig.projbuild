## firmware/esp-idf-datachannel/main/Kconfig.projbuild
```kconfig
menu "Stack-chan ESP-IDF DataChannel probe"

config STACKCHAN_WIFI_SSID
    string "Wi-Fi SSID"
    default ""
    help
        Local Wi-Fi SSID. Do not commit a real credential in sdkconfig.defaults.

config STACKCHAN_WIFI_PASSWORD
    string "Wi-Fi password"
    default ""
    help
        Local Wi-Fi password. Do not commit a real credential in sdkconfig.defaults.

config STACKCHAN_SIGNAL_BASE_URL
    string "AppRTC signaling base URL"
    default "http://192.168.7.135:18091"
    help
        LAN-reachable base URL for src/apprtc-signal.js, without a trailing slash.

config STACKCHAN_SIGNAL_ROOM
    string "AppRTC signaling room"
    default "stackchan"

choice STACKCHAN_PEER_ROLE
    prompt "WebRTC offerer role"
    default STACKCHAN_PEER_ROLE_BROWSER_OFFERER
    help
        Select which side creates the initial SDP offer. Browser offerer keeps
        the CoreS3 in the controlled role. ESP offerer lets the CoreS3 create
        and send the initial offer after the websocket opens.

config STACKCHAN_PEER_ROLE_BROWSER_OFFERER
    bool "Browser offerer: CoreS3 answers"

config STACKCHAN_PEER_ROLE_ESP_OFFERER
    bool "ESP offerer: CoreS3 offers"

endchoice

config STACKCHAN_LOG_PAYLOAD_PREFIX
    int "Payload prefix bytes to log"
    default 96
    range 16 512
    help
        Bounded prefix length for serial logs of signaling payloads.

config STACKCHAN_AGENT_RECV_TIMEOUT_MS
    int "esp_peer ICE/DTLS agent receive timeout milliseconds"
    default 5000
    range 100 5000
    help
        Receive timeout passed to esp_peer_default_cfg_t.agent_recv_timeout.
        Public smartphone relay paths can add enough TURN latency that the
        previous 100 ms value repeatedly timed out during DTLS handshake after
        ICE reached connected. Keep this configurable so local LAN runs can be
        compared against longer relay-friendly values.

choice STACKCHAN_MEDIA_MODE
    prompt "WebRTC media mode"
    default STACKCHAN_MEDIA_AUDIO_TEST_SOURCE
    help
        Select the native media shape to negotiate with the browser probe.

config STACKCHAN_MEDIA_NONE
    bool "None: DataChannel only"

config STACKCHAN_MEDIA_AUDIO_TEST_SOURCE
    bool "Audio: generated PCMA test source"
    help
        Negotiate a send-only audio track and send generated 8 kHz G.711 A-law
        tone frames. This proves RTP/media transport and audible playback before
        wiring CoreS3 I2S capture.

config STACKCHAN_MEDIA_CORE_S3_MIC_SOURCE
    bool "Audio: CoreS3 ES7210 microphone source"
    help
        Negotiate a send-only audio track, capture CoreS3 microphone samples
        from the ES7210 I2S data output, convert PCM16 to G.711 A-law, and
        send 8 kHz mono 20 ms-equivalent frames with explicit PTS through
        esp_peer_send_audio(). This raw bridge is intentionally narrow because
        esp_capture is not yet part of this component set; replace it with the
        esp_capture audio_dev_src/sink path when that dependency is adopted.
        Keep the generated source as the default known-good transport baseline.

config STACKCHAN_MEDIA_CORE_S3_MIC_DUPLEX
    bool "Audio: CoreS3 ES7210 microphone source + browser receive decode"
    help
        Negotiate sendrecv audio explicitly for bidirectional proof. CoreS3
        keeps the ES7210 microphone -> browser PCMA path running, receives
        browser microphone PCMA frames, decodes them to PCM16, and logs receive
        and decode counters. This mode does not enable speaker I2S output.

config STACKCHAN_MEDIA_VIDEO_PLACEHOLDER
    bool "Video placeholder: documented only"
    help
        Reserved for a later camera/MJPEG or H.264 source. This option logs that
        video is not implemented and keeps media disabled so DataChannel remains
        testable.

endchoice

config STACKCHAN_AUDIO_TEST_INTERVAL_MS
    int "Audio test frame interval milliseconds"
    default 20
    range 20 100
    depends on STACKCHAN_MEDIA_AUDIO_TEST_SOURCE

config STACKCHAN_AUDIO_TEST_FRAME_BYTES
    int "Audio test PCMA frame bytes"
    default 160
    range 80 320
    depends on STACKCHAN_MEDIA_AUDIO_TEST_SOURCE
    help
        160 bytes is 20 ms of 8 kHz mono G.711 A-law audio.

config STACKCHAN_CORE_S3_MIC_FRAME_SAMPLES
    int "CoreS3 microphone frame samples"
    default 160
    range 80 320
    depends on STACKCHAN_MEDIA_CORE_S3_MIC_SOURCE || STACKCHAN_MEDIA_CORE_S3_MIC_DUPLEX
    help
        160 samples is 20 ms at the default 8 kHz sample rate.

config STACKCHAN_CORE_S3_MIC_I2C_SDA_GPIO
    int "CoreS3 ES7210 I2C SDA GPIO"
    default 12
    depends on STACKCHAN_MEDIA_CORE_S3_MIC_SOURCE || STACKCHAN_MEDIA_CORE_S3_MIC_DUPLEX

config STACKCHAN_CORE_S3_MIC_I2C_SCL_GPIO
    int "CoreS3 ES7210 I2C SCL GPIO"
    default 11
    depends on STACKCHAN_MEDIA_CORE_S3_MIC_SOURCE || STACKCHAN_MEDIA_CORE_S3_MIC_DUPLEX

config STACKCHAN_CORE_S3_MIC_I2S_MCLK_GPIO
    int "CoreS3 ES7210 I2S MCLK GPIO"
    default 0
    depends on STACKCHAN_MEDIA_CORE_S3_MIC_SOURCE || STACKCHAN_MEDIA_CORE_S3_MIC_DUPLEX

config STACKCHAN_CORE_S3_MIC_I2S_BCLK_GPIO
    int "CoreS3 ES7210 I2S BCLK GPIO"
    default 34
    depends on STACKCHAN_MEDIA_CORE_S3_MIC_SOURCE || STACKCHAN_MEDIA_CORE_S3_MIC_DUPLEX

config STACKCHAN_CORE_S3_MIC_I2S_WS_GPIO
    int "CoreS3 ES7210 I2S WS GPIO"
    default 33
    depends on STACKCHAN_MEDIA_CORE_S3_MIC_SOURCE || STACKCHAN_MEDIA_CORE_S3_MIC_DUPLEX

config STACKCHAN_CORE_S3_MIC_I2S_DIN_GPIO
    int "CoreS3 ES7210 I2S DATO-to-ESP GPIO"
    default 14
    depends on STACKCHAN_MEDIA_CORE_S3_MIC_SOURCE || STACKCHAN_MEDIA_CORE_S3_MIC_DUPLEX

endmenu
```

## firmware/esp-idf-datachannel/sdkconfig.defaults
```kconfig
CONFIG_ESP_MAIN_TASK_STACK_SIZE=8192
CONFIG_ESP_SYSTEM_EVENT_TASK_STACK_SIZE=4096
CONFIG_ESP_WIFI_STATIC_RX_BUFFER_NUM=8
CONFIG_ESP_WIFI_DYNAMIC_RX_BUFFER_NUM=32
CONFIG_MBEDTLS_SSL_PROTO_DTLS=y
CONFIG_MBEDTLS_SSL_DTLS_SRTP=y
CONFIG_MBEDTLS_X509_CREATE_C=y
CONFIG_MBEDTLS_ECP_DP_SECP256R1_ENABLED=y
```

## firmware/esp-idf-speaker-tone/sdkconfig.defaults
```kconfig
CONFIG_IDF_TARGET="esp32s3"
CONFIG_ESPTOOLPY_FLASHSIZE_16MB=y
CONFIG_PARTITION_TABLE_SINGLE_APP_LARGE=y
CONFIG_ESP_TASK_WDT_TIMEOUT_S=10
```
